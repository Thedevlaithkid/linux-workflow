## configs/devlaith_defconfig
```kconfig
BR2_x86_64=y
BR2_TOOLCHAIN_BUILDROOT_CXX=y
BR2_INIT_BUSYBOX=y
BR2_TARGET_GENERIC_HOSTNAME="devlaith"
BR2_TARGET_GENERIC_ISSUE="Welcome to DevLaith Linux"
BR2_ROOTFS_OVERLAY="$(BR2_EXTERNAL_DEVLAITH_PATH)/board/overlay"
BR2_PACKAGE_BUSYBOX=y
BR2_PACKAGE_BASH=y
BR2_PACKAGE_UTIL_LINUX=y
BR2_PACKAGE_OPENSSH=y
BR2_TARGET_ROOTFS_EXT2=y
BR2_TARGET_ROOTFS_EXT2_4=y
BR2_TARGET_ROOTFS_ISO9660=y
BR2_TARGET_ROOTFS_ISO9660_HYBRID=y
BR2_LINUX_KERNEL=y
BR2_LINUX_KERNEL_CUSTOM_VERSION=y
BR2_LINUX_KERNEL_CUSTOM_VERSION_VALUE="6.6.72"
BR2_LINUX_KERNEL_DEFCONFIG="x86_64"
```
